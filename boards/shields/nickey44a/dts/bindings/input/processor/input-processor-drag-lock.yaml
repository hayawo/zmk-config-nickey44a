## boards/shields/nickey44a/dts/bindings/input/processor/input-processor-drag-lock.yaml
```yaml
description: Keep a long-press drag button held briefly after the finger lifts
compatible: "zmk,input-processor-drag-lock"
include: ip_zero_param.yaml
properties:
  input-device:
    type: phandle
    required: true
    description: Input device that reports the button; used to inject the delayed release.
  button-code:
    type: int
    required: true
    description: INPUT_EV_KEY code of the drag button (INPUT_BTN_0).
  touch-code:
    type: int
    required: true
    description: INPUT_EV_KEY code reporting finger contact (INPUT_BTN_TOUCH).
  tap-ms:
    type: int
    default: 40
    description: Presses shorter than this are taps, not drags.
  lock-ms:
    type: int
    default: 800
    description: How long the button stays held after the finger lifts.
```

## boards/shields/nickey44a/dts/bindings/input/processor/input-processor-layer-drag.yaml
```yaml
description: Hold a mouse button while dragging on a trackpad with a layer active
compatible: "zmk,input-processor-layer-drag"
include: ip_zero_param.yaml
properties:
  input-device:
    type: phandle
    required: true
    description: Input device used to inject the button press/release.
  layer:
    type: int
    required: true
  button-code:
    type: int
    required: true
    description: INPUT_EV_KEY code to hold (INPUT_BTN_0).
  touch-code:
    type: int
    required: true
    description: INPUT_EV_KEY code reporting finger contact (INPUT_BTN_TOUCH).
  move-threshold:
    type: int
    default: 4
    description: Movement (sum of |REL_X|+|REL_Y|) before the button is pressed.
```

## boards/shields/nickey44a/dts/bindings/input/processor/input-processor-mod-scaler.yaml
```yaml
description: Scale cursor movement while a modifier is held
compatible: "zmk,input-processor-mod-scaler"
include: ip_zero_param.yaml
properties:
  mods:
    type: int
    required: true
    description: Explicit modifier bit mask (e.g. MOD_LALT | MOD_RALT).
  multiplier:
    type: int
    default: 1
  divisor:
    type: int
    default: 4
```

## boards/shields/nickey44a/dts/bindings/input/processor/input-processor-report-throttle.yaml
```yaml
description: Merge relative movement so at most one report is sent per interval
compatible: "zmk,input-processor-report-throttle"
include: ip_zero_param.yaml
properties:
  input-device:
    type: phandle
    required: true
    description: Input device used to inject the delayed flush event.
  min-interval-ms:
    type: int
    default: 15
```

## config/west.yml
```yaml
manifest:
  remotes:
    - name: zmkfirmware
      url-base: https://github.com/zmkfirmware
    - name: cormoran
      url-base: https://github.com/cormoran
    - name: caksoylar  # <-- RGB LED
      url-base: https://github.com/caksoylar
    - name: geeksville
      url-base: https://github.com/geeksville
    - name: sekigon-gonnoc
      url-base: https://github.com/sekigon-gonnoc
  projects:
    - name: zmk
      remote: cormoran
      revision: 3931facea7507151a53f209ca4f8a717fa6bd400 # v0.3-branch+dya
      import: app/west.yml
    - name: zmk-rgbled-widget
      remote: caksoylar
      revision: 8756cb7b8114069fa3c25c6f6c990f24988fceff # v0.3
    - name: zmk_driver_azoteq
      remote: geeksville
      revision: 66d510249d139569a4060c35bd78c6a2159f83ed
    - name: zmk-driver-hires-dial
      remote: sekigon-gonnoc
      revision: 353a21964a2f6df1de128ca6e71ec63518729ab7 # master 2026-09
  self:
    path: config
```
